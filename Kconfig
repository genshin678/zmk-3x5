## boards/shields/zmk_3x5_bt/Kconfig.shield
```kconfig
# Copyright (c) 2026
# SPDX-License-Identifier: MIT

config SHIELD_ZMK_3X5_BT
    def_bool $(shields_list_contains,zmk_3x5_bt)
```

## config/west.yml
```yaml
manifest:
  remotes:
    - name: zmkfirmware
      url-base: https://github.com/zmkfirmware
    - name: genshin678
      url-base: https://github.com/genshin678
  projects:
    - name: zmk
      remote: genshin678
      repo-path: zmk-1
      revision: keep-adv-v0.3
      import: app/west.yml
  self:
    path: config
```

## modules/zmk-rgb-player/zephyr/dts/bindings/zmk,behavior-bri-dual-hold.yaml
```yaml
description: Brightness loop when two keys are held simultaneously
compatible: zmk,behavior-bri-dual-hold
binding-cells: []
```

## modules/zmk-rgb-player/zephyr/dts/bindings/zmk,behavior-bt-clear-bonds.yaml
```yaml
description: Clear all BLE bonds (U+M+O+. combo) to restore discoverable advertising
compatible: zmk,behavior-bt-clear-bonds
binding-cells: []
```

## modules/zmk-rgb-player/zephyr/dts/bindings/zmk,behavior-dfu-combo.yaml
```yaml
description: 'DFU combo: two keys held 3s → reboot to bootloader'
compatible: zmk,behavior-dfu-combo
binding-cells: []
```

## modules/zmk-rgb-player/zephyr/dts/bindings/zmk,behavior-effect-cycle.yaml
```yaml
description: Cycle to the next RGB effect on each activation
compatible: zmk,behavior-effect-cycle
binding-cells: []
```

## modules/zmk-rgb-player/zephyr/dts/bindings/zmk,behavior-hue-dual-hold.yaml
```yaml
description: Hue loop when two keys are held simultaneously
compatible: zmk,behavior-hue-dual-hold
binding-cells: []
```

## modules/zmk-rgb-player/zephyr/dts/bindings/zmk,behavior-kp-with-effect.yaml
```yaml
description: >
  Type a key AND trigger the ripple effect.
  param1: HID *usage ID* from the Keyboard/Keypad page 0x07 - e.g. Y = 0x1C,
          O = 0x12, I = 0x0C, N = 0x11, M = 0x10. This is NOT a "scancode" and
          NOT (usage - 4); zmk_hid_keyboard_press() wants the raw usage ID.
          Prefer dt-bindings/zmk/keys.h symbols when authoring a keymap.
  param2: key index 0-14 (for ripple origin), or -1 to skip effect
  (The two binding-cell names below are historical; param1 is the usage ID.)
compatible: zmk,behavior-kp-with-effect
binding-cells:
  - scancode
  - key-index
```

## modules/zmk-rgb-player/zephyr/dts/bindings/zmk,behavior-out-guard.yaml
```yaml
description: >
  Toggle the active output endpoint (USB / Bluetooth), exactly like the stock
  &out OUT_TOG, but refuse to do so while a score is playing. Exists so that a
  combo bound to keys a score can ask for (I+K) cannot steal the link mid-song.
compatible: zmk,behavior-out-guard
binding-cells: []
```

## modules/zmk-rgb-player/zephyr/dts/bindings/zmk,behavior-user-kp.yaml
```yaml
description: >
  Runtime-remappable manual key behavior. Drop-in replacement for the stock
  &kp on the 15 main keys. On press/release it emits the HID usage stored in
  user_keymap_table[event.position] (configured over BLE; default = 光遇
  layout) instead of a compile-time binding, so the mapping is whatever the
  user configured. Combos still work: when a combo captures a key's position
  events the behavior is never invoked, exactly as with stock &kp, so keys
  that double as combo triggers keep their letter suppressed during a chord.
compatible: zmk,behavior-user-kp
binding-cells: []
```
